#include <stdint.h>
#include <avr/interrupt.h>
#include <avr/io.h>
#include <avr/pgmspace.h>
#include <math.h>

#define SAMPLE_RATE 8000
const int sounddata_length=12000;
const unsigned char sounddata_data[] PROGMEM ={128, 
128, 128, 128, 128, 128, 128, 130, 111, 95, 98, 97, 99, 99, 100, 96, 94, 94, 90, 95, 94, 
90, 92, 90, 92, 89, 87, 90, 90, 91, 92, 94, 93, 88, 91, 95, 97, 99, 100, 102, 105, 
110, 114, 115, 116, 117, 118, 123, 126, 126, 130, 130, 132, 135, 136, 142, 142, 140, 143, 146, 147, 
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122, 123, 126, 128, 134, 135, 129, 129, 134, 137, 134, 129, 127, 126, 127, 124, 120, 121, 122, };

// Definicje
const int trigPin = 13;
const int echoPin = 12;
const int speakerPin = 11; 
volatile uint16_t sample;
byte lastSample;


void stopPlayback()
{
    // Disable playback per-sample interrupt.
    TIMSK1 &= ~_BV(OCIE1A);

    // Disable the per-sample timer completely.
    TCCR1B &= ~_BV(CS10);

    // Disable the PWM timer.
    TCCR2B &= ~_BV(CS10);

    digitalWrite(speakerPin, LOW);
}

// This is called at 8000 Hz to load the next sample.
ISR(TIMER1_COMPA_vect) {
    if (sample >= sounddata_length) {
        if (sample == sounddata_length + lastSample) {
            stopPlayback();
        }
        else {
            if(speakerPin==11){
                // Ramp down to zero to reduce the click at the end of playback.
                OCR2A = sounddata_length + lastSample - sample;
            } else {
                OCR2B = sounddata_length + lastSample - sample;                
            }
        }
    }
    else {
        if(speakerPin==11){
            OCR2A = pgm_read_byte(&sounddata_data[sample]);
        } else {
            OCR2B = pgm_read_byte(&sounddata_data[sample]);            
        }
    }

    ++sample;
}

void startPlayback(float szybkosc, float glosnosc)
{
    pinMode(speakerPin, OUTPUT);

    // Set up Timer 2 to do pulse width modulation on the speaker
    // pin.

    // Use internal clock (datasheet p.160)
    ASSR &= ~(_BV(EXCLK) | _BV(AS2));

    // Set fast PWM mode  (p.157)
    TCCR2A |= _BV(WGM21) | _BV(WGM20);
    TCCR2B &= ~_BV(WGM22);

    if(speakerPin==11){
        // Do non-inverting PWM on pin OC2A (p.155)
        // On the Arduino this is pin 11.
        TCCR2A = (TCCR2A | _BV(COM2A1)) & ~_BV(COM2A0);
        TCCR2A &= ~(_BV(COM2B1) | _BV(COM2B0));
        // No prescaler (p.158)
        TCCR2B = (TCCR2B & ~(_BV(CS12) | _BV(CS11))) | _BV(CS10);

        // Set initial pulse width to the first sample.
        OCR2A = (int)(pgm_read_byte(&sounddata_data[0])*glosnosc);
    } else {
        // Do non-inverting PWM on pin OC2B (p.155)
        // On the Arduino this is pin 3.
        TCCR2A = (TCCR2A | _BV(COM2B1)) & ~_BV(COM2B0);
        TCCR2A &= ~(_BV(COM2A1) | _BV(COM2A0));
        // No prescaler (p.158)
        TCCR2B = (TCCR2B & ~(_BV(CS12) | _BV(CS11))) | _BV(CS10);

        // Set initial pulse width to the first sample.
        OCR2B = pgm_read_byte(&sounddata_data[0]);
    }

    // Set up Timer 1 to send a sample every interrupt.

    cli();

    // Set CTC mode (Clear Timer on Compare Match) (p.133)
    // Have to set OCR1A *after*, otherwise it gets reset to 0!
    TCCR1B = (TCCR1B & ~_BV(WGM13)) | _BV(WGM12);
    TCCR1A = TCCR1A & ~(_BV(WGM11) | _BV(WGM10));

    // No prescaler (p.134)
    TCCR1B = (TCCR1B & ~(_BV(CS12) | _BV(CS11))) | _BV(CS10);

    // Set the compare register (OCR1A).
    // OCR1A is a 16-bit register, so we have to do this with
    // interrupts disabled to be safe.
    OCR1A = F_CPU / (int)(SAMPLE_RATE*szybkosc);    // 16e6 / 8000 = 2000

    // Enable interrupt when TCNT1 == OCR1A (p.136)
    TIMSK1 |= _BV(OCIE1A);

    lastSample = pgm_read_byte(&sounddata_data[sounddata_length-1]);
    sample = 0;
    sei();
}


void setup()
{
  Serial.begin(9600);
  pinMode(trigPin, OUTPUT);
  pinMode(echoPin, INPUT);    
}

long duration, distance, lastDistance;
boolean ruch =  false;
float glosnosc = 1.0f;
float szybkosc = 1.0f;

void loop()
{
  // wysylanie fali
  digitalWrite(trigPin, LOW);
  delayMicroseconds(2);
  digitalWrite(trigPin, HIGH);
  delayMicroseconds(10);
  digitalWrite(trigPin, LOW);
  //lapanie fali
  duration = pulseIn(echoPin, HIGH);
  distance = duration / 58.2;
  //wykrywanie ruchu
  Serial.println("-------------------");
  Serial.print("Distance: ");
  Serial.println(distance);
  Serial.print("LastDistance: ");
  Serial.println(lastDistance);
  if( lastDistance == 0 ){
    lastDistance = distance;
  }
  else{    
    int roznica = (int)abs(lastDistance - distance);
    Serial.print("Roznica: ");
    Serial.println(roznica);
    if( roznica > (int)(0.3f*lastDistance)){
      ruch = !ruch;
      if(ruch){
        glosnosc = 0.5f + static_cast <float> (rand()) /( static_cast <float> (RAND_MAX));
        szybkosc = 0.8f + static_cast <float> (rand()) /( static_cast <float> (RAND_MAX/0.4f));
        Serial.println("-------------------------------");
        Serial.print("Glosnosc:");
        Serial.println(glosnosc);
        Serial.print("Szybkosc:");
        Serial.println(szybkosc);
        startPlayback(szybkosc, glosnosc);
      }
    }    
  }
  lastDistance = distance;
  delay(1000);
}

